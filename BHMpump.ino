#include <SPI.h>
#include <Wire.h>
#include <Adafruit_GFX.h>
#include <Adafruit_SSD1306.h>

// The pins for I2C are defined by the Wire-library. 
// On an arduino UNO:       A4(SDA), A5(SCL)
#define SCREEN_WIDTH 128 // in pixels
#define SCREEN_HEIGHT 32 
#define OLED_RESET     4 // Reset pin #
#define SCREEN_ADDRESS 0x3C ///< See datasheet for Address; 0x3D for 128x64, 0x3C for 128x32
Adafruit_SSD1306 display(SCREEN_WIDTH, SCREEN_HEIGHT, &Wire, OLED_RESET);

//SickKids logo
#define SKLOGO_WIDTH    128
#define SKLOGO_HEIGHT   32
static const unsigned char PROGMEM skLogo_bmp[] =
{ 0x00, 0x00, 0x00, 0x00, 0x00, 0x00, 0x00, 0x00, 0x00, 0x00, 0x00, 0x00, 0x00, 0x00, 0x00, 0x00, 
  0x00, 0x00, 0x1f, 0x00, 0x00, 0x00, 0x00, 0x00, 0x00, 0x00, 0x00, 0x00, 0x00, 0x00, 0x00, 0x00, 
  0x00, 0x00, 0x3f, 0xc3, 0xe0, 0x00, 0x3e, 0x00, 0x78, 0x3c, 0x78, 0x00, 0xf0, 0x00, 0x00, 0x00, 
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  0x00, 0x00, 0x00, 0x00, 0x00, 0x00, 0x00, 0x00, 0x00, 0x00, 0x00, 0x00, 0x00, 0x00, 0x00, 0x00};


//initialize
double currentMillis = 0;  
int pressure = 0;
int peakPressure = 0;
int n = 0;
int bpm = 60;
float period = 0;



// Pressure waveform lookup table, amplitude range:0 - 225
const int WAVEREZ = 32;
int waveform[WAVEREZ] = { 113,134,156,175,192,206,216,223,225,223,216,206,
192,175,156,134,113,91,69,50,33,19,9,2,0,2,9,19,33,50,69,91,};


void setup() 
{
  pinMode(9, OUTPUT);
  //pinMode(10, OUTPUT);
  Serial.begin(9600);
  
  // SSD1306_SWITCHCAPVCC = generate display voltage from 3.3V internally
  if(!display.begin(SSD1306_SWITCHCAPVCC, SCREEN_ADDRESS)) 
  {
    Serial.println(F("SSD1306 allocation failed"));
    for(;;); // Don't proceed, loop forever
  }

  splash(2000);
}

void loop() 
{
  //Serial.println(bpm); // debugging
  //display BPM & Pressure
  if (millis()%10 == 0)
  {
    display.clearDisplay();
    display.setCursor(0, 0);
    display.print(F("BPM: "));
    display.print(bpm);
    display.display();  // problem with timing here
  }
  
  analogWrite(9, pressure);
  peakPressure = map(analogRead(0), 0, 1023, 0, 255);

  if (n >= 0 && n < WAVEREZ) 
  {
    pressure = map(waveform[n], 0, 255, 0, peakPressure);
    n ++;
  }
  else
  {
    n = 0;
  }
  
  bpm = map(analogRead(1), 0,1023, 30, 230);
  period = 60000 / (bpm * WAVEREZ); //convert BPM to cycle period
  currentMillis = millis();
  while(millis() <= currentMillis + period){ } //wait cycle period
}

void splash(int milliSplash)
{
  display.clearDisplay();
  //Logo
  display.drawBitmap(
    (display.width()  - SKLOGO_WIDTH ) / 2,
    (display.height() - SKLOGO_HEIGHT) / 2,
    skLogo_bmp, SKLOGO_WIDTH, SKLOGO_HEIGHT, 1);
  display.display();
  delay(milliSplash); // splash time
  display.clearDisplay();
  //text
  display.setTextSize(1); 
  display.setTextColor(SSD1306_WHITE);
  display.setCursor(10, 15);
  display.print(F("HOST-BHM R2"));
  display.display();     
}
